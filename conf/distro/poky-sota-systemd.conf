## conf/distro/poky-sota-systemd.conf
```bitbake
require conf/distro/poky.conf

require conf/distro/sota.conf.inc

DISTRO = "poky-sota-systemd"
DISTRO_NAME = "OTA-enabled Linux"
DISTRO_VERSION = "1.0"
DISTRO_CODENAME = "sota"

DISTRO_FEATURES:append = " systemd"
VIRTUAL-RUNTIME_init_manager = "systemd"
PREFERRED_RPROVIDER_network-configuration ??= "networkd-dhcp-conf"
```

## conf/distro/poky-sota.conf
```bitbake
require conf/distro/poky.conf
require conf/distro/sota.conf.inc

DISTRO = "poky-sota"
DISTRO_NAME = "OTA-enabled Linux"
DISTRO_VERSION = "1.0"
DISTRO_CODENAME = "sota"

IMAGE_INSTALL:append:sota = " ostree-booted"
```

## conf/distro/sota.conf.inc
```bitbake
# Common settings to enable SOTA
# This can be pulled into a custom distribution, or included in
# local.conf directly with:
#
# require conf/distro/sota.conf.inc

DISTRO_FEATURES:append = " sota usrmerge"
DISTRO_FEATURES_NATIVE:append = " sota"
INHERIT += " sota"

# Reproducible builds are enabled by default since kirkstone
# Use 0 as mtime, the same as OSTree is using.
export SOURCE_DATE_EPOCH = "0"
REPRODUCIBLE_TIMESTAMP_ROOTFS = "0"

HOSTTOOLS += "git sync sha256sum"
HOSTTOOLS_NONFATAL += "java repo"
```

## conf/layer.conf
```bitbake
# We have a conf and classes directory, add to BBPATH
BBPATH .= ":${LAYERDIR}"

# We have recipes-* directories, add to BBFILES
BBFILES += "${LAYERDIR}/recipes-*/*/*.bb \
	${LAYERDIR}/recipes-*/*/*.bbappend"

BBFILE_COLLECTIONS += "sota"
BBFILE_PATTERN_sota = "^${LAYERDIR}/"
BBFILE_PRIORITY_sota = "7"

LAYERDEPENDS_sota = "openembedded-layer"
LAYERDEPENDS_sota += "meta-python"
LAYERDEPENDS_sota += "filesystems-layer"
LAYERSERIES_COMPAT_sota = "dunfell gatesgarth hardknott honister"

SIGGEN_EXCLUDE_SAFE_RECIPE_DEPS += " \
  aktualizr-device-prov->aktualizr \
  aktualizr-device-prov-hsm->aktualizr \
  aktualizr-shared-prov->aktualizr \
  aktualizr-shared-prov-creds->aktualizr \
  aktualizr-uboot-env-rollback->aktualizr \
"
```

## conf/machine/qemux86-ota.conf
```bitbake
#@TYPE: Machine
#@NAME: common_pc
#@DESCRIPTION: Machine configuration for running a common x86

PREFERRED_PROVIDER_virtual/xserver ?= "xserver-xorg"
PREFERRED_PROVIDER_virtual/libgl ?= "mesa"
PREFERRED_PROVIDER_virtual/libgles1 ?= "mesa"
PREFERRED_PROVIDER_virtual/libgles2 ?= "mesa"

require conf/machine/include/qemu.inc
require conf/machine/include/tune-i586.inc

KERNEL_IMAGETYPE = "bzImage"

PREFERRED_PROVIDER_virtual/bootloader = "u-boot-buildrom"
UBOOT_MACHINE = "qemu-x86_defconfig"

IMAGE_CLASSES += "image_types_ota"
IMAGE_FSTYPES += "otaimg"

SERIAL_CONSOLES = "115200;ttyS0 115200;ttyS1"

XSERVER = "xserver-xorg \
           ${@bb.utils.contains('DISTRO_FEATURES', 'opengl', 'mesa-driver-swrast xserver-xorg-extension-glx', '', d)} \
           xf86-input-vmmouse \
           xf86-input-keyboard \
           xf86-input-evdev \
           xf86-video-cirrus \
           xf86-video-fbdev \
           xf86-video-vmware"

MACHINE_FEATURES += "x86"

MACHINE_ESSENTIAL_EXTRA_RDEPENDS += "v86d"

MACHINEOVERRIDES .= ":qemux86"
KMACHINE = "qemux86"
```

## meta-sota-minnowboard/conf/layer.conf
```bitbake
# We have a conf and classes directory, add to BBPATH
BBPATH =. "${LAYERDIR}:"

# We have recipes-* directories, add to BBFILES
BBFILES += "${LAYERDIR}/recipes-*/*/*.bb \
            ${LAYERDIR}/recipes-*/*/*.bbappend"

BBFILE_COLLECTIONS += "sota-minnowboard"
BBFILE_PATTERN_sota-minnowboard = "^${LAYERDIR}/"
BBFILE_PRIORITY_sota-minnowboard = "7"

LAYERSERIES_COMPAT_sota-minnowboard = "sumo"
```

## meta-sota-qemux86-64/conf/layer.conf
```bitbake
# We have a conf and classes directory, add to BBPATH
BBPATH =. "${LAYERDIR}:"

# We have recipes-* directories, add to BBFILES
BBFILES += "${LAYERDIR}/recipes-*/*/*.bb \
            ${LAYERDIR}/recipes-*/*/*.bbappend"

BBFILE_COLLECTIONS += "updater-qemux86-64"
BBFILE_PATTERN_updater-qemux86-64 = "^${LAYERDIR}/"
BBFILE_PRIORITY_updater-qemux86-64 = "7"
```

## meta-sota-raspberrypi/conf/bblayers.conf.sample
```bitbake
# LAYER_CONF_VERSION is increased each time build/conf/bblayers.conf
# changes incompatibly
LCONF_VERSION = "6"

BBPATH = "${TOPDIR}"
BBFILES ?= ""

BBLAYERS ?= " \
  ##OEROOT##/meta \
  ##OEROOT##/meta-yocto \
  ##OEROOT##/meta-yocto-bsp \
  ##OEROOT##/../meta-raspberrypi \
  ##OEROOT##/../meta-updater \
  ##OEROOT##/../meta-updater-raspberrypi \
  ##OEROOT##/../meta-openembedded/meta-oe \
  ##OEROOT##/../meta-openembedded/meta-filesystems \
  ##OEROOT##/../meta-openembedded/meta-python \
  ##OEROOT##/../meta-rust \
  "
BBLAYERS_NON_REMOVABLE ?= " \
  ##OEROOT##/meta \
  ##OEROOT##/meta-yocto \
  "
```

## meta-sota-raspberrypi/conf/layer.conf
```bitbake
# We have a conf and classes directory, add to BBPATH
BBPATH =. "${LAYERDIR}:"

# We have recipes-* directories, add to BBFILES
BBFILES += "${LAYERDIR}/recipes-*/*/*.bb \
            ${LAYERDIR}/recipes-*/*/*.bbappend"

BBFILE_COLLECTIONS += "sota-raspberrypi"
BBFILE_PATTERN_sota-raspberrypi = "^${LAYERDIR}/"
BBFILE_PRIORITY_sota-raspberrypi = "7"

LAYERSERIES_COMPAT_sota-raspberrypi = "sumo"
```

## meta-sota/conf/distro/poky-sota-systemd.conf
```bitbake
require conf/distro/poky.conf

require conf/distro/sota.conf.inc

DISTRO = "poky-sota"
DISTRO_NAME = "OTA-enabled Linux"
DISTRO_VERSION = "1.0"
DISTRO_CODENAME = "sota"

DISTRO_FEATURES_append = " systemd"
VIRTUAL-RUNTIME_init_manager = "systemd"

IMAGE_INSTALL_append = " connman connman-client"
```

## meta-sota/conf/distro/sota.conf.inc
```bitbake
# Common settings to enable SOTA
# This can be pulled into a custom distribution, or included in
# local.conf directly with:
#
# require conf/distro/sota.conf.inc

DISTRO_FEATURES_append = " sota"
DISTRO_FEATURES_NATIVE_append = " sota"
INHERIT += " sota"
# Prelinking increases the size of downloads and causes build errors
USER_CLASSES_remove = "image-prelink"

HOSTTOOLS_append = " sync sha256sum"
```

## scripts/lib/wic/canned-wks/efiimage-sota.wks
```
# short-description: Create an OTA-enabled EFI disk image
# long-description: Creates an OTA-enabled EFI disk image that the user
# can directly dd to boot media.

part /boot --source bootimg-efi --sourceparams="loader=grub-efi" --ondisk hda --label msdos --active --align 1024
part / --source otaimage --ondisk hda --fstype=ext4 --mkfs-extraopts='-F -i 8192 -O ^64bit' --label otaroot --align 1024 --use-uuid

bootloader --ptable gpt --timeout=5 --append="rootfstype=ext4 console=ttyS0,115200 console=tty0" --configfile="grub-ota.cfg"
```

## scripts/lib/wic/canned-wks/ls1043ardb-ota.wks
```
# short-description: Create SD card OTA image for NXP LS1043ARDB
# long-description:
# Create an OTA-enabled image that can be written onto a SD card using dd
# for use with NXP LS1043ARDB SoC.
# For data layout see Layerscape SDK User Guide, Chapter 4.2, tables 14 and 16.
#
part BL2 --source rawcopy2 --sourceparams="file=atf/bl2_sd.pbl" --ondisk mmcblk --no-table --align 4
part BL3 --source rawcopy2 --sourceparams="file=atf/fip_uboot.bin" --ondisk mmcblk --no-table --align 1024
part fman-ucode --source rawcopy2 --sourceparams="file=fsl_fman_ucode_ls1043_r1.1_108_4_9.bin" --ondisk mmcblk --no-table --align 9216
part qe-ucode --source rawcopy2 --sourceparams="file=boot/fsl_qe_ucode_1021_10_A.bin" --ondisk mmcblk --no-table --align 9472
part uboot-scr --source bootimg-partition --ondisk mmcblk --fstype=msdos --fixed-size=100M --align 65540
part / --source otaimage --ondisk mmcblk --fstype=ext4 --label root --align 167940

bootloader --ptable msdos
```
